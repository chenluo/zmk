## app/boards/arm/nrf_12u_split/Kconfig
```kconfig
config BOARD_NRF_CHARGER
    bool "Enable battery charger"
    default y
    depends on (BOARD_NRF_12U_SPLIT_L || BOARD_NRF_12U_SPLIT_R)

config BOARD_ENABLE_DCDC
    bool "Enable DCDC mode"
    select SOC_DCDC_NRF52X
    default y
    depends on (BOARD_NRF_12U_SPLIT_L || BOARD_NRF_12U_SPLIT_R)

config BOARD_NRF_12U_SPLIT_LEFT
    bool

config BOARD_NRF_12U_SPLIT_RIGHT
    bool
```

## app/boards/arm/nrf_12u_split/Kconfig.board
```kconfig
# nrfmicro board configuration

# Copyright (c) 2020 The ZMK Contributors
# SPDX-License-Identifier: MIT

config BOARD_NRF_12U_SPLIT_L
    bool "nrf_12u_split_833_left"
    depends on SOC_NRF52833_QIAA
    select BOARD_NRF_12U_SPLIT_LEFT

config BOARD_NRF_12U_SPLIT_R
    bool "nrf_12u_split_833_right"
    depends on SOC_NRF52833_QIAA
    select BOARD_NRF_12U_SPLIT_RIGHT

config BOARD_NRF_12U_SPLIT_840_LEFT
    bool "nrf_12u_split_840_left"
    depends on SOC_NRF52840_QIAA
    select BOARD_NRF_12U_SPLIT_LEFT

config BOARD_NRF_12U_SPLIT_840_RIGHT
    bool "nrf_12u_split_840_right"
    depends on SOC_NRF52840_QIAA
    select BOARD_NRF_12U_SPLIT_RIGHT
```

## app/boards/arm/nrf_12u_split/Kconfig.defconfig
```kconfig
# Electronut Labs Papyr board configuration

# Copyright (c) 2020 The ZMK Contributors
# SPDX-License-Identifier: MIT
if BOARD_NRF_12U_SPLIT_LEFT
    config ZMK_KEYBOARD_NAME
        default "nrf_12u_split"

    config ZMK_SPLIT_ROLE_CENTRAL
        default y

endif 

if BOARD_NRF_12U_SPLIT_LEFT || BOARD_NRF_12U_SPLIT_RIGHT

config BOARD
    default "nrf_12u_split"

config ZMK_SPLIT
    default y

if USB_DEVICE_STACK

config USB_NRFX
    default y

endif # USB_DEVICE_STACK

config BT_CTLR
    default BT

config BOARD_NRF_CHARGER
    default y

if ZMK_BACKLIGHT

config PWM
    default y

config LED_PWM
    default y

endif # ZMK_BACKLIGHT


endif # BOARD_NRF_12U_SPLIT
```

## app/boards/arm/nrf_12u_split/nrf_12u_split_833_right_defconfig
```kconfig
# SPDX-License-Identifier: MIT

# v1 soldered 1.5u. space row only has a single layout.

CONFIG_SOC_SERIES_NRF52X=y
CONFIG_SOC_NRF52833_QIAA=y
CONFIG_BOARD_NRF_12U_SPLIT_R=y

# Enable MPU
CONFIG_ARM_MPU=y

CONFIG_PINCTRL=y

# enable GPIO
CONFIG_GPIO=y

CONFIG_USE_DT_CODE_PARTITION=y
CONFIG_BUILD_OUTPUT_UF2=y

CONFIG_MPU_ALLOW_FLASH_WRITE=y
CONFIG_NVS=y
CONFIG_SETTINGS_NVS=y
CONFIG_FLASH=y
CONFIG_FLASH_PAGE_LAYOUT=y
CONFIG_FLASH_MAP=y
CONFIG_CLOCK_CONTROL_NRF=y
CONFIG_CLOCK_CONTROL_NRF_K32SRC_RC=y

CONFIG_ZMK_USB=y
CONFIG_ZMK_BLE=y

CONFIG_ZMK_STUDIO=y
CONFIG_ZMK_POINTING=y

# backlight
# CONFIG_ZMK_BACKLIGHT=y


# # led strip
# CONFIG_ZMK_RGB_UNDERGLOW=y
# # Use the STRIP config specific to the LEDs you're using
# CONFIG_WS2812_STRIP=y
# CONFIG_ZMK_RGB_UNDERGLOW_EFF_START=2
# CONFIG_ZMK_RGB_UNDERGLOW_HUE_START=50
# CONFIG_ZMK_RGB_UNDERGLOW_ON_START=y
# CONFIG_ZMK_RGB_UNDERGLOW_SPD_START=2
# CONFIG_ZMK_RGB_UNDERGLOW_BRT_START=10
# CONFIG_ZMK_RGB_UNDERGLOW_AUTO_OFF_IDLE=n
# CONFIG_ZMK_RGB_UNDERGLOW_AUTO_OFF_USB=n
# CONFIG_ZMK_RGB_UNDERGLOW_EXT_POWER=n
```

## app/boards/arm/nrf_34_r2_11u/Kconfig
```kconfig
config BOARD_NRF_CHARGER
    bool "Enable battery charger"
    default y
    depends on (BOARD_NRF_34_R2_833)

config BOARD_ENABLE_DCDC
    bool "Enable DCDC mode"
    select SOC_DCDC_NRF52X
    default y
    depends on (BOARD_NRF_34_R2_833)
```

## app/boards/arm/nrf_34_r2_11u/Kconfig.board
```kconfig
# nrfmicro board configuration

# Copyright (c) 2020 The ZMK Contributors
# SPDX-License-Identifier: MIT

config BOARD_NRF_34_R2_833
    bool "nrf_34_R2_833"
    depends on SOC_NRF52833_QIAA
```

## app/boards/arm/nrf_34_r2_11u/Kconfig.defconfig
```kconfig
# Electronut Labs Papyr board configuration

# Copyright (c) 2020 The ZMK Contributors
# SPDX-License-Identifier: MIT

if BOARD_NRF_34_R2_833

config ZMK_KEYBOARD_NAME
    default "nrf_34_R2"

config BOARD
    default "nrf_34_R2"

if USB_DEVICE_STACK

config USB_NRFX
    default y

endif # USB_DEVICE_STACK

config BT_CTLR
    default BT


config BOARD_NRF_CHARGER
    default y

if ZMK_BACKLIGHT

config PWM
    default y

config LED_PWM
    default y

endif # ZMK_BACKLIGHT


endif # BOARD_NRF_34_R2_833
```

## app/boards/arm/nrf_34_r2_11u/nrf_34_r2_833_defconfig
```kconfig
# SPDX-License-Identifier: MIT

# v1 soldered 1.5u. space row only has a single layout.

CONFIG_SOC_SERIES_NRF52X=y
CONFIG_SOC_NRF52833_QIAA=y
CONFIG_BOARD_NRF_34_R2_833=y

# Enable MPU
CONFIG_ARM_MPU=y

CONFIG_PINCTRL=y

# enable GPIO
CONFIG_GPIO=y

CONFIG_USE_DT_CODE_PARTITION=y
CONFIG_BUILD_OUTPUT_UF2=y

CONFIG_MPU_ALLOW_FLASH_WRITE=y
CONFIG_NVS=y
CONFIG_SETTINGS_NVS=y
CONFIG_FLASH=y
CONFIG_FLASH_PAGE_LAYOUT=y
CONFIG_FLASH_MAP=y
CONFIG_CLOCK_CONTROL_NRF=y
CONFIG_CLOCK_CONTROL_NRF_K32SRC_RC=y

CONFIG_ZMK_USB=y
CONFIG_ZMK_BLE=y

CONFIG_ZMK_STUDIO=n
CONFIG_ZMK_POINTING=y

# backlight
# CONFIG_ZMK_BACKLIGHT=y


# led strip
CONFIG_ZMK_RGB_UNDERGLOW=y
# Use the STRIP config specific to the LEDs you're using
CONFIG_WS2812_STRIP=y
CONFIG_ZMK_RGB_UNDERGLOW_EFF_START=3
CONFIG_ZMK_RGB_UNDERGLOW_HUE_START=100
CONFIG_ZMK_RGB_UNDERGLOW_ON_START=y
CONFIG_ZMK_RGB_UNDERGLOW_SPD_START=5
```

## app/boards/arm/nrf_bdw/Kconfig
```kconfig
config BOARD_NRF_CHARGER
    bool "Enable battery charger"
    default y
    depends on (BOARD_NRF_BDW_840 || BOARD_NRF_BDW_833 || BOARD_NRF_BDW_833_V2 )

config BOARD_ENABLE_DCDC
    bool "Enable DCDC mode"
    select SOC_DCDC_NRF52X
    default y
    depends on (BOARD_NRF_BDW_840 || BOARD_NRF_BDW_833 || BOARD_NRF_BDW_833_V2 )
```

## app/boards/arm/nrf_bdw/Kconfig.board
```kconfig
# nrfmicro board configuration

# Copyright (c) 2020 The ZMK Contributors
# SPDX-License-Identifier: MIT

config BOARD_NRF_BDW_840
    bool "nrf_bdw_840"
    depends on SOC_NRF52840_QIAA

config BOARD_NRF_BDW_833
    bool "nrf_bdw_833"
    depends on SOC_NRF52833_QIAA

config BOARD_TEST
    bool "nrf_test"
    depends on SOC_NRF52833_QIAA
```

## app/boards/arm/nrf_bdw/Kconfig.defconfig
```kconfig
# Electronut Labs Papyr board configuration

# Copyright (c) 2020 The ZMK Contributors
# SPDX-License-Identifier: MIT

if BOARD_NRF_BDW_840 || BOARD_NRF_BDW_833

config ZMK_KEYBOARD_NAME
    default "bdw_1027_2139"

config BOARD
    default "nrf_bdw"

if USB_DEVICE_STACK

config USB_NRFX
    default y

endif # USB_DEVICE_STACK

config BT_CTLR
    default BT


config BOARD_NRF_CHARGER
    default y

endif # BOARD_NRF_BDW_840 || BOARD_NRF_BDW_833
```
